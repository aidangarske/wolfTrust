## tests/firmware/zephyr-stm32h5/module/wolfpsa/Kconfig
```kconfig
menuconfig WOLFPSA
	bool "wolfPSA Crypto engine (PSA API over wolfCrypt + wolfHSM)"
	depends on WOLFTRUST_WOLFHSM_CLIENT
	depends on !MBEDTLS
	depends on !BUILD_WITH_TFM
	help
	  Link the lib/wolfPSA submodule into the Zephyr image and expose
	  the PSA Crypto API on top of wolfCrypt. The wolfPSA glue calls
	  wolfPSA_SetDefaultDevID(WH_DEV_ID) in its SYS_INIT hook so every
	  psa_*() call routes through the wolfHSM client (registered by
	  the wolfhsm-client module) and across the CMSE boundary into
	  the secure side. Mutually exclusive with Zephyr's bundled
	  mbedTLS PSA front-end and TF-M.
```

## tests/firmware/zephyr-stm32h5/module/wolftrust-tee/Kconfig
```kconfig
menuconfig WOLFTRUST_ZEPHYR
	bool "wolfTrust CMSE client glue"
	depends on ARM
	help
	  Build the non-secure wolfTrust client glue used by the Zephyr STM32H563
	  guest apps in this subtree.

if WOLFTRUST_ZEPHYR

config WOLFTRUST_TEE_DRIVER
	bool "wolfTrust Zephyr TEE driver"
	depends on TEE
	default y if DT_HAS_WOLFSSL_WOLFTRUST_TEE_ENABLED
	help
	  Expose the wolfTrust secure side through Zephyr's standard tee
	  subsystem. The driver dispatches tee_invoke_func calls to CMSE
	  veneers into wolfTrust.

endif # WOLFTRUST_ZEPHYR
```

## prj.conf
```kconfig
CONFIG_BUILD_WITH_TFM=n
# ECDH shared-secret + HKDF derivation (dev_apis c020/c080) needs more heap
# than the 8K default; the crypto guest holds ~40K RAM headroom over stack+heap.
CONFIG_COMMON_LIBC_MALLOC_ARENA_SIZE=16384
CONFIG_CONSOLE=y
CONFIG_LOG=y
CONFIG_LOG_DEFAULT_LEVEL=3
CONFIG_LOG_MODE_IMMEDIATE=y
# ES256 verification uses a large SP math frame on Cortex-M33.
CONFIG_MAIN_STACK_SIZE=16384
CONFIG_PRINTK=y
CONFIG_SERIAL=y
CONFIG_TRUSTED_EXECUTION_NONSECURE=y
CONFIG_UART_CONSOLE=y
CONFIG_WOLFTRUST_ZEPHYR=y
CONFIG_TEE=y
CONFIG_WOLFTRUST_TEE_DRIVER=y
CONFIG_WOLFTRUST_WOLFHSM_CLIENT=y
CONFIG_WOLFPSA=y
```

## src/attestation_verify.c
```c
/* attestation_verify.c
 *
 * Copyright (C) 2026 wolfSSL Inc.
 *
 * This file is part of wolfTrust.
 *
 * wolfTrust is free software; you can redistribute it and/or modify
 * it under the terms of the GNU General Public License as published by
 * the Free Software Foundation; either version 3 of the License, or
 * (at your option) any later version.
 *
 * wolfTrust is distributed in the hope that it will be useful,
 * but WITHOUT ANY WARRANTY; without even the implied warranty of
 * MERCHANTABILITY or FITNESS FOR A PARTICULAR PURPOSE.  See the
 * GNU General Public License for more details.
 *
 * You should have received a copy of the GNU General Public License
 * along with this program; if not, see <https://www.gnu.org/licenses/>.
 */

#include "attestation_verify.h"

#include <wolfcose/wolfcose.h>
#include <wolfssl/wolfcrypt/ecc.h>

#include <string.h>

#define WT_EAT_CLAIM_NONCE 10
#define WT_EAT_CLAIM_UEID 256
#define WT_EAT_CLAIM_PROFILE 265
#define WT_EAT_CLAIM_BOOT_SEED 268
#define WT_PSA_CLAIM_CLIENT_ID 2394
#define WT_PSA_CLAIM_LIFECYCLE 2395
#define WT_PSA_CLAIM_IMPLEMENTATION_ID 2396
#define WT_PSA_CLAIM_SW_COMPONENTS 2399
#define WT_PSA_SW_MEASUREMENT_TYPE 1
#define WT_PSA_SW_MEASUREMENT_VALUE 2
#define WT_PSA_SW_MEASUREMENT_SIGNER_ID 5
#define WT_PSA_SW_MEASUREMENT_DESCRIPTION 6
#define WT_REQUIRED_CLAIMS 0xFFu
static const char g_expected_profile[] = "tag:psacertified.org,2023:psa#tfm";

static int wt_hex_nibble(char value)
{
    if ((value >= '0') && (value <= '9')) {
        return value - '0';
    }
    if ((value >= 'a') && (value <= 'f')) {
        return value - 'a' + 10;
    }
    if ((value >= 'A') && (value <= 'F')) {
        return value - 'A' + 10;
    }
    return -1;
}

static int wt_decode_measurement(const char* hex, uint8_t* measurement)
{
    size_t i;
    int high;
    int low;

    if ((hex == NULL) || (measurement == NULL) || (strlen(hex) != 64u)) {
        return -1;
    }
    for (i = 0u; i < 32u; ++i) {
        high = wt_hex_nibble(hex[i * 2u]);
        low = wt_hex_nibble(hex[(i * 2u) + 1u]);
        if ((high < 0) || (low < 0)) {
            return -1;
        }
        measurement[i] = (uint8_t)((high << 4) | low);
    }
    return 0;
}

/* Component zero is the wolfTrust runtime and is verified strictly; later
 * components are the launch-verified guest measurements (WT-FFM-0049) and
 * must be well-formed measurement/signer pairs. When expectedMeasurement is
 * NULL the component-zero digest is reported, not compared, so the harness
 * can hold the reference value outside the image under test. */
static int wt_verify_software_component(WOLFCOSE_CBOR_CTX* cbor,
    const uint8_t* expectedMeasurement, uint8_t* tokenMeasurement)
{
    static const uint8_t type[] = "sha-256";
    static const uint8_t description[] = "wolftrust";
    const uint8_t* data;
    size_t dataSize;
    size_t arrayCount;
    size_t mapCount;
    size_t component;
    size_t i;
    int64_t label;
    uint32_t fields;
    int ret;

    ret = wc_CBOR_DecodeArrayStart(cbor, &arrayCount);
    if ((ret != 0) || (arrayCount < 1u)) {
        return -1;
    }
    for (component = 0u; (ret == 0) && (component < arrayCount);
         ++component) {
        fields = 0u;
        ret = wc_CBOR_DecodeMapStart(cbor, &mapCount);
        for (i = 0u; (ret == 0) && (i < mapCount); ++i) {
            ret = wc_CBOR_DecodeInt(cbor, &label);
            if ((ret == 0) && (component != 0u)) {
                if (label == WT_PSA_SW_MEASUREMENT_VALUE) {
                    ret = wc_CBOR_DecodeBstr(cbor, &data, &dataSize);
                    if ((ret == 0) && (dataSize == 32u)) {
                        fields |= 2u;
                    }
                    else {
                        ret = -1;
                    }
                }
                else if (label == WT_PSA_SW_MEASUREMENT_SIGNER_ID) {
                    ret = wc_CBOR_DecodeBstr(cbor, &data, &dataSize);
                    if ((ret == 0) && (dataSize == 32u)) {
                        fields |= 8u;
                    }
                    else {
                        ret = -1;
                    }
                }
                else {
                    ret = wc_CBOR_Skip(cbor);
                }
                continue;
            }
            if ((ret == 0) && (label == WT_PSA_SW_MEASUREMENT_TYPE)) {
                ret = wc_CBOR_DecodeTstr(cbor, &data, &dataSize);
                if ((ret == 0) && (dataSize == sizeof(type) - 1u) &&
                    (memcmp(data, type, dataSize) == 0)) {
                    fields |= 1u;
                }
                else {
                    ret = -1;
                }
            }
            else if ((ret == 0) && (label == WT_PSA_SW_MEASUREMENT_VALUE)) {
                ret = wc_CBOR_DecodeBstr(cbor, &data, &dataSize);
                if ((ret == 0) && (dataSize == 32u) &&
                    ((expectedMeasurement == NULL) ||
                     (memcmp(data, expectedMeasurement, dataSize) == 0))) {
                    if (tokenMeasurement != NULL) {
                        (void)memcpy(tokenMeasurement, data, dataSize);
                    }
                    fields |= 2u;
                }
                else {
                    ret = -1;
                }
            }
            else if ((ret == 0) &&
                     (label == WT_PSA_SW_MEASUREMENT_DESCRIPTION)) {
                ret = wc_CBOR_DecodeTstr(cbor, &data, &dataSize);
                if ((ret == 0) && (dataSize == sizeof(description) - 1u) &&
                    (memcmp(data, description, dataSize) == 0)) {
                    fields |= 4u;
                }
                else {
                    ret = -1;
                }
            }
            else if ((ret == 0) &&
                     (label == WT_PSA_SW_MEASUREMENT_SIGNER_ID)) {
                ret = wc_CBOR_DecodeBstr(cbor, &data, &dataSize);
                if ((ret == 0) && (dataSize == 32u)) {
                    fields |= 8u;
                }
                else {
                    ret = -1;
                }
            }
            else if (ret == 0) {
                ret = wc_CBOR_Skip(cbor);
            }
        }
        /* RFC 9783 4.4.1.4: every software component carries a Signer ID;
         * a token missing one must fail verification (WT-FFM-0064). */
        if (ret == 0) {
            if (component == 0u) {
                ret = (fields == 15u) ? 0 : -1;
            }
            else {
                ret = ((fields & 10u) == 10u) ? 0 : -1;
            }
        }
    }
    return (ret == 0) ? 0 : -1;
}

static int wt_verify_claims(const uint8_t* payload, size_t payloadSize,
    const uint8_t* challenge, size_t challengeSize,
    const uint8_t* expectedMeasurement, uint32_t expectedLifecycle,
    uint32_t* verifiedLifecycle, uint8_t* tokenMeasurement)
{
    WOLFCOSE_CBOR_CTX cbor;
    const uint8_t* data;
    size_t dataSize;
    size_t mapCount;
    size_t i;
    int64_t label;
    int64_t signedValue;
    uint64_t value;
    uint32_t claims = 0u;
    int ret;

    (void)memset(&cbor, 0, sizeof(cbor));
    cbor.cbuf = payload;
    cbor.bufSz = payloadSize;
    ret = wc_CBOR_DecodeMapStart(&cbor, &mapCount);
    for (i = 0u; (ret == 0) && (i < mapCount); ++i) {
        ret = wc_CBOR_DecodeInt(&cbor, &label);
        if ((ret == 0) && (label == WT_EAT_CLAIM_NONCE)) {
            ret = wc_CBOR_DecodeBstr(&cbor, &data, &dataSize);
            if ((ret == 0) && (dataSize == challengeSize) &&
                (memcmp(data, challenge, challengeSize) == 0)) {
                claims |= 1u;
            }
            else {
                ret = -1;
            }
        }
        else if ((ret == 0) && (label == WT_EAT_CLAIM_UEID)) {
            ret = wc_CBOR_DecodeBstr(&cbor, &data, &dataSize);
            if ((ret == 0) && (dataSize == 33u) && (data[0] == 0x01u)) {
                claims |= 2u;
            }
            else {
                ret = -1;
            }
        }
        else if ((ret == 0) && (label == WT_EAT_CLAIM_PROFILE)) {
            ret = wc_CBOR_DecodeTstr(&cbor, &data, &dataSize);
            if ((ret == 0) && (dataSize == sizeof(g_expected_profile) - 1u) &&
                (memcmp(data, g_expected_profile, dataSize) == 0)) {
                claims |= 64u;
            }
            else {
                ret = -1;
            }
        }
        else if ((ret == 0) && (label == WT_EAT_CLAIM_BOOT_SEED)) {
            ret = wc_CBOR_DecodeBstr(&cbor, &data, &dataSize);
            if ((ret == 0) && (dataSize == 32u)) {
                claims |= 128u;
            }
            else {
                ret = -1;
            }
        }
        else if ((ret == 0) && (label == WT_PSA_CLAIM_CLIENT_ID)) {
            ret = wc_CBOR_DecodeInt(&cbor, &signedValue);
            /* guest0 is the first NSPE client: its PSA client id is -1, and
             * any nonnegative id in the claim is a spoofed secure caller. */
            if ((ret == 0) && (signedValue == -1)) {
                claims |= 4u;
            }
            else {
                ret = -1;
            }
        }
        else if ((ret == 0) &&
                 (label == WT_PSA_CLAIM_IMPLEMENTATION_ID)) {
            ret = wc_CBOR_DecodeBstr(&cbor, &data, &dataSize);
            if ((ret == 0) && (dataSize == 32u)) {
                claims |= 8u;
            }
            else {
                ret = -1;
            }
        }
        else if ((ret == 0) && (label == WT_PSA_CLAIM_LIFECYCLE)) {
            ret = wc_CBOR_DecodeUint(&cbor, &value);
            if ((ret == 0) && (value <= UINT32_MAX)) {
                *verifiedLifecycle = (uint32_t)value;
            }
            if ((ret == 0) && (value == expectedLifecycle)) {
                claims |= 16u;
            }
            else {
                ret = -1;
            }
        }
        else if ((ret == 0) && (label == WT_PSA_CLAIM_SW_COMPONENTS)) {
            ret = wt_verify_software_component(&cbor, expectedMeasurement,
                                               tokenMeasurement);
            if (ret == 0) {
                claims |= 32u;
            }
        }
        else if (ret == 0) {
            ret = wc_CBOR_Skip(&cbor);
        }
    }
    if ((ret == 0) && (cbor.idx != payloadSize)) {
        ret = -1;
    }
    return ((ret == 0) && (claims == WT_REQUIRED_CLAIMS)) ? 0 : -1;
}

int wt_attestation_verify_ex(const uint8_t* token, size_t tokenSize,
    const uint8_t* publicKey, size_t publicKeySize,
    const uint8_t* challenge, size_t challengeSize,
    const char* expectedMeasurementHex, uint32_t expectedLifecycle,
    uint32_t* verifiedLifecycle, uint8_t* tokenMeasurement)
{
    uint8_t expectedMeasurement[32];
    const uint8_t* expected = NULL;
    uint8_t scratch[640];
    const uint8_t* payload = NULL;
    size_t payloadSize = 0u;
    WOLFCOSE_HDR header;
    WOLFCOSE_KEY coseKey;
    ecc_key eccKey;
    int coseKeyInited = 0;
    int eccKeyInited = 0;
    int ret;

    if ((token == NULL) || (publicKey == NULL) || (publicKeySize != 65u) ||
        (publicKey[0] != 0x04u) || (challenge == NULL) ||
        (verifiedLifecycle == NULL)) {
        return -1;
    }
    *verifiedLifecycle = 0u;
    /* An absent expected measurement selects report-only mode: the token
     * digest is returned for the caller (harness) to compare against a
     * reference held outside the image under test. */
    if ((expectedMeasurementHex != NULL) &&
        (expectedMeasurementHex[0] != '\0')) {
        ret = wt_decode_measurement(expectedMeasurementHex,
                                    expectedMeasurement);
        if (ret != 0) {
            return ret;
        }
        expected = expectedMeasurement;
    }

    ret = wc_ecc_init(&eccKey);
    if (ret == 0) {
        eccKeyInited = 1;
        ret = wc_ecc_import_unsigned(&eccKey, &publicKey[1], &publicKey[33],
                                     NULL, ECC_SECP256R1);
    }
    if (ret == 0) {
        ret = wc_CoseKey_Init(&coseKey);
        if (ret == 0) {
            coseKeyInited = 1;
            ret = wc_CoseKey_SetEcc(&coseKey, WOLFCOSE_CRV_P256, &eccKey);
        }
    }
    if (ret == 0) {
        (void)memset(&header, 0, sizeof(header));
        ret = wc_CoseSign1_Verify(&coseKey, token, tokenSize, NULL, 0u,
            NULL, 0u, scratch, sizeof(scratch), &header, &payload,
            &payloadSize);
    }
    if ((ret == 0) && (header.alg != WOLFCOSE_ALG_ES256)) {
        ret = -1;
    }
    if (ret == 0) {
        ret = wt_verify_claims(payload, payloadSize, challenge, challengeSize,
                               expected, expectedLifecycle,
                               verifiedLifecycle, tokenMeasurement);
    }

    if (coseKeyInited != 0) {
        wc_CoseKey_Free(&coseKey);
    }
    if (eccKeyInited != 0) {
        wc_ecc_free(&eccKey);
    }
    (void)memset(expectedMeasurement, 0, sizeof(expectedMeasurement));
    (void)memset(scratch, 0, sizeof(scratch));
    return ret;
}

int wt_attestation_verify(const uint8_t* token, size_t tokenSize,
    const uint8_t* publicKey, size_t publicKeySize,
    const uint8_t* challenge, size_t challengeSize,
    const char* expectedMeasurementHex, uint32_t expectedLifecycle,
    uint32_t* verifiedLifecycle)
{
    return wt_attestation_verify_ex(token, tokenSize, publicKey,
        publicKeySize, challenge, challengeSize, expectedMeasurementHex,
        expectedLifecycle, verifiedLifecycle, NULL);
}
```

## src/attestation_verify.h
```c
/* attestation_verify.h
 *
 * Copyright (C) 2026 wolfSSL Inc.
 *
 * This file is part of wolfTrust.
 *
 * wolfTrust is free software; you can redistribute it and/or modify
 * it under the terms of the GNU General Public License as published by
 * the Free Software Foundation; either version 3 of the License, or
 * (at your option) any later version.
 *
 * wolfTrust is distributed in the hope that it will be useful,
 * but WITHOUT ANY WARRANTY; without even the implied warranty of
 * MERCHANTABILITY or FITNESS FOR A PARTICULAR PURPOSE.  See the
 * GNU General Public License for more details.
 *
 * You should have received a copy of the GNU General Public License
 * along with this program; if not, see <https://www.gnu.org/licenses/>.
 */

#ifndef WOLFTRUST_ATTESTATION_VERIFY_H
#define WOLFTRUST_ATTESTATION_VERIFY_H

#include <stddef.h>
#include <stdint.h>

int wt_attestation_verify(const uint8_t* token, size_t tokenSize,
    const uint8_t* publicKey, size_t publicKeySize,
    const uint8_t* challenge, size_t challengeSize,
    const char* expectedMeasurementHex, uint32_t expectedLifecycle,
    uint32_t* verifiedLifecycle);

/* As wt_attestation_verify, plus: a NULL or empty expectedMeasurementHex
 * skips the component-zero comparison (report-only mode), and a non-NULL
 * tokenMeasurement receives the 32-byte component-zero digest so the harness
 * can compare it against a reference held outside the image under test. */
int wt_attestation_verify_ex(const uint8_t* token, size_t tokenSize,
    const uint8_t* publicKey, size_t publicKeySize,
    const uint8_t* challenge, size_t challengeSize,
    const char* expectedMeasurementHex, uint32_t expectedLifecycle,
    uint32_t* verifiedLifecycle, uint8_t* tokenMeasurement);

#endif /* WOLFTRUST_ATTESTATION_VERIFY_H */
```

## src/conformance_pal.c
```c
/* conformance_pal.c
 *
 * Copyright (C) 2026 wolfSSL Inc.
 *
 * This file is part of wolfTrust.
 *
 * wolfTrust is free software; you can redistribute it and/or modify
 * it under the terms of the GNU General Public License as published by
 * the Free Software Foundation; either version 3 of the License, or
 * (at your option) any later version.
 *
 * wolfTrust is distributed in the hope that it will be useful,
 * but WITHOUT ANY WARRANTY; without even the implied warranty of
 * MERCHANTABILITY or FITNESS FOR A PARTICULAR PURPOSE.  See the
 * GNU General Public License for more details.
 *
 * You should have received a copy of the GNU General Public License
 * along with this program; if not, see <https://www.gnu.org/licenses/>.
 */

/* Non-secure PAL + PSA client shim for the Arm psa-arch-tests val NSPE (P3a-4a).
 * The val framework prints through a single char sink (pal_print) and reaches
 * the SPM through the PSA client API, which aliases wolfTrust's CMSE veneers.
 * pal_print_ns is unused (VERBOSITY path funnels to val_printf -> pal_print);
 * the crypto/storage/attestation PALs are unused by the IPC suite and refuse. */

#include <stdint.h>
#include <stdarg.h>
#include <stddef.h>
#include <string.h>

#include <zephyr/kernel.h>

/* This TU implements the real PSA client API; without IPC defined the
 * dev_apis builds get pal_common.h's fallback psa_invec/psa_outvec typedefs,
 * which collide with psa/client.h. */
#ifndef IPC
#define IPC 1
#endif

#include "psa/client.h"
#include "psa_manifest/sid.h"
#include "pal_common.h"
#include "wolftrust/ffm_veneer.h"

#include "psa/storage_common.h"
#include "psa/internal_trusted_storage.h"
#include "psa/protected_storage.h"

#if defined(INITIAL_ATTESTATION)
#include <wolftrust/attestation.h>
#endif

extern int32_t WolfTrust_FFM_Connect(uint32_t sid, uint32_t version);
extern int32_t WolfTrust_FFM_Call(int32_t handle, int32_t type,
                                  wt_ffm_veneer_iovec_t* ns_iovec);
extern void WolfTrust_FFM_Close(int32_t handle);

#if defined(WT_CONF_TRACE)
#define WT_CONF_TRACE_PRINT(...) printk(__VA_ARGS__)
#else
#define WT_CONF_TRACE_PRINT(...)
#endif

/* psa_connect/psa_call/psa_close now come from the OS-neutral client core
 * (src/client/psa_ffm_client.c) that this build links (P7-S2); the val NSPE
 * reaches the SPM through the same neutral client the production guest uses. */

/* The val shared status region (PLATFORM_SHARED_REGION_BASE aliases this). The
 * NS framework records per-test status here; a plain BSS buffer suffices. */
uint8_t test_status_buffer[256] = {0};

/* val's log sink: one character at a time to the guest console. */
int pal_print(uint8_t c)
{
    printk("%c", (char)c);
    return 0;
}

/* val records its per-test boot/status state in NVMEM. P3b routes both NS and
 * SPE val through the DRIVER partition's NVMEM service so the two frameworks
 * share one store (nvmem_param_t invec + data vec, the suite's own driver
 * protocol). The backing store is the SPE PAL's RAM block until the P5
 * reboot-continuity work makes it reset-surviving. */
static psa_status_t wt_conf_nvm_call(uint32_t fn_type, uint32_t offset,
                                     void* buffer, size_t size)
{
    nvmem_param_t param;
    psa_invec invec[2];
    psa_outvec outvec[1];
    psa_handle_t handle;
    psa_status_t status;

    param.nvmem_fn_type = (nvmem_fn_type_t)fn_type;
    param.base = (addr_t)PLATFORM_NVM_BASE;
    param.offset = offset;
    param.size = (int)size;
    handle = psa_connect(DRIVER_NVMEM_SID, DRIVER_NVMEM_VERSION);
    if (handle <= 0) {
        return PSA_ERROR_CONNECTION_REFUSED;
    }
    invec[0].base = &param;
    invec[0].len = sizeof(param);
    if (fn_type == (uint32_t)NVMEM_WRITE) {
        invec[1].base = buffer;
        invec[1].len = size;
        status = psa_call(handle, 0, invec, 2u, NULL, 0u);
    }
    else {
        outvec[0].base = buffer;
        outvec[0].len = size;
        status = psa_call(handle, 0, invec, 1u, outvec, 1u);
    }
    psa_close(handle);
    return status;
}

int pal_nvm_read(uint32_t offset, void* buffer, size_t size)
{
    if (buffer == NULL) {
        return 1;
    }
    if (wt_conf_nvm_call((uint32_t)NVMEM_READ, offset, buffer, size) !=
            PSA_SUCCESS) {
        return 1;
    }
    return 0;
}

int pal_nvm_write(uint32_t offset, void* buffer, size_t size)
{
    if (buffer == NULL) {
        return 1;
    }
    if (wt_conf_nvm_call((uint32_t)NVMEM_WRITE, offset, buffer, size) !=
            PSA_SUCCESS) {
        return 1;
    }
    return 0;
}

int pal_watchdog_enable(void)
{
    return 0;
}

int pal_watchdog_disable(void)
{
    return 0;
}

int pal_uart_init_ns(void)
{
    return 0;
}

int pal_wd_timer_init_ns(uint32_t time_us, uint32_t timer_tick_us)
{
    (void)time_us;
    (void)timer_tick_us;
    return 0;
}

int pal_wd_timer_enable_ns(void)
{
    return 0;
}

int pal_wd_timer_disable_ns(void)
{
    return 0;
}

int pal_system_reset(void)
{
    return 0;
}

void pal_terminate_simulation(void)
{
    printk("wolfTrust FF-M conformance: val_entry returned\n");
}

/* dev_apis Crypto builds compile the upstream pal_crypto_intf.c instead. */
#if !defined(CRYPTO)
int32_t pal_crypto_function(int type, va_list valist)
{
    (void)type;
    (void)valist;
    return -1;
}
#endif

/* dev_apis Storage (P4-S6): dispatch the val ITS/PS function codes to the
 * OS-neutral PSA storage client (src/client/psa_storage_client.c), which
 * marshals each onto SERVICE_ITS / SERVICE_PS over FF-M IPC. The code values
 * are val_storage.h's
 * storage_function_type_t: ITS SET/GET/GET_INFO/REMOVE = 0x1..0x4,
 * PS SET/GET/GET_INFO/REMOVE/CREATE/SET_EXTENDED/GET_SUPPORT = 0x5..0xB. */
uint32_t pal_its_function(int type, va_list valist)
{
    psa_storage_uid_t uid;
    uint32_t data_size;
    uint32_t offset;
    const void* p_write_data;
    void* p_read_data;
    size_t* p_data_length;
    psa_storage_create_flags_t create_flags;
    struct psa_storage_info_t* p_info;

    switch (type) {
    case 0x1: /* VAL_ITS_SET */
        uid = va_arg(valist, psa_storage_uid_t);
        data_size = va_arg(valist, uint32_t);
        p_write_data = va_arg(valist, const void*);
        create_flags = va_arg(valist, psa_storage_create_flags_t);
        return (uint32_t)psa_its_set(uid, data_size, p_write_data,
                                     create_flags);
    case 0x2: /* VAL_ITS_GET */
        uid = va_arg(valist, psa_storage_uid_t);
        offset = va_arg(valist, uint32_t);
        data_size = va_arg(valist, uint32_t);
        p_read_data = va_arg(valist, void*);
        p_data_length = va_arg(valist, size_t*);
        return (uint32_t)psa_its_get(uid, offset, data_size, p_read_data,
                                     p_data_length);
    case 0x3: /* VAL_ITS_GET_INFO */
        uid = va_arg(valist, psa_storage_uid_t);
        p_info = va_arg(valist, struct psa_storage_info_t*);
        return (uint32_t)psa_its_get_info(uid, p_info);
    case 0x4: /* VAL_ITS_REMOVE */
        uid = va_arg(valist, psa_storage_uid_t);
        return (uint32_t)psa_its_remove(uid);
    default:
        return PAL_STATUS_UNSUPPORTED_FUNC;
    }
}

uint32_t pal_ps_function(int type, va_list valist)
{
    psa_storage_uid_t uid;
    uint32_t data_size;
    uint32_t size;
    uint32_t offset;
    const void* p_write_data;
    void* p_read_data;
    size_t* p_data_length;
    psa_storage_create_flags_t create_flags;
    struct psa_storage_info_t* p_info;

    switch (type) {
    case 0x5: /* VAL_PS_SET */
        uid = va_arg(valist, psa_storage_uid_t);
        data_size = va_arg(valist, uint32_t);
        p_write_data = va_arg(valist, const void*);
        create_flags = va_arg(valist, psa_storage_create_flags_t);
        return (uint32_t)psa_ps_set(uid, data_size, p_write_data,
                                    create_flags);
    case 0x6: /* VAL_PS_GET */
        uid = va_arg(valist, psa_storage_uid_t);
        offset = va_arg(valist, uint32_t);
        data_size = va_arg(valist, uint32_t);
        p_read_data = va_arg(valist, void*);
        p_data_length = va_arg(valist, size_t*);
        return (uint32_t)psa_ps_get(uid, offset, data_size, p_read_data,
                                    p_data_length);
    case 0x7: /* VAL_PS_GET_INFO */
        uid = va_arg(valist, psa_storage_uid_t);
        p_info = va_arg(valist, struct psa_storage_info_t*);
        return (uint32_t)psa_ps_get_info(uid, p_info);
    case 0x8: /* VAL_PS_REMOVE */
        uid = va_arg(valist, psa_storage_uid_t);
        return (uint32_t)psa_ps_remove(uid);
    case 0x9: /* VAL_PS_CREATE */
        uid = va_arg(valist, psa_storage_uid_t);
        size = va_arg(valist, uint32_t);
        create_flags = va_arg(valist, psa_storage_create_flags_t);
        return (uint32_t)psa_ps_create(uid, size, create_flags);
    case 0xA: /* VAL_PS_SET_EXTENDED */
        uid = va_arg(valist, psa_storage_uid_t);
        offset = va_arg(valist, uint32_t);
        data_size = va_arg(valist, uint32_t);
        p_write_data = va_arg(valist, const void*);
        return (uint32_t)psa_ps_set_extended(uid, offset, data_size,
                                             p_write_data);
    case 0xB: /* VAL_PS_GET_SUPPORT */
        return psa_ps_get_support();
    default:
        return PAL_STATUS_UNSUPPORTED_FUNC;
    }
}

/* dev_apis Initial Attestation builds compile the upstream
 * pal_attestation_intf.c/pal_attestation_crypto.c instead; the val-side
 * verify needs the device's real IAK public key, which is generated inside
 * the wolfHSM vault at provisioning and only reachable at runtime. */
#if defined(INITIAL_ATTESTATION)
int32_t tfm_initial_attest_get_public_key(uint8_t* public_key_buff,
    size_t public_key_buf_size, size_t* public_key_len,
    psa_ecc_family_t* elliptic_family_type)
{
    psa_status_t status;

    if ((public_key_buff == NULL) || (public_key_len == NULL) ||
            (elliptic_family_type == NULL)) {
        return PSA_ERROR_INVALID_ARGUMENT;
    }
    status = wolftrust_attestation_get_iak_public_key(public_key_buff,
                                                      public_key_buf_size,
                                                      public_key_len);
    if (status != PSA_SUCCESS) {
        return status;
    }
    *elliptic_family_type = PSA_ECC_FAMILY_SECP_R1;
    return PSA_SUCCESS;
}
#else
int32_t pal_attestation_function(int type, va_list valist)
{
    (void)type;
    (void)valist;
    return -1;
}
#endif
```

## src/psa_storage_ns.c
```c
/* psa_storage_ns.c
 *
 * Copyright (C) 2026 wolfSSL Inc.
 *
 * This file is part of wolfTrust.
 *
 * wolfTrust is free software; you can redistribute it and/or modify
 * it under the terms of the GNU General Public License as published by
 * the Free Software Foundation; either version 3 of the License, or
 * (at your option) any later version.
 *
 * wolfTrust is distributed in the hope that it will be useful,
 * but WITHOUT ANY WARRANTY; without even the implied warranty of
 * MERCHANTABILITY or FITNESS FOR A PARTICULAR PURPOSE.  See the
 * GNU General Public License for more details.
 *
 * You should have received a copy of the GNU General Public License
 * along with this program; if not, see <https://www.gnu.org/licenses/>.
 */

/* Non-secure client shim for PSA ITS/PS (P4-S6). The dev_apis Storage suite
 * calls the psa_its and psa_ps families; this translates each into an FF-M
 * IPC request to SERVICE_ITS / SERVICE_PS through the CMSE veneer
 * (psa_connect/psa_call from conformance_pal.c). The wire matches
 * src/services/storage_service.c: one
 * concatenated input vector [header][data] on writes, header alone on reads,
 * the reply in output vector 0. The SPM stamps the caller identity, so the
 * vault namespaces every object under this guest automatically. */

#include <stdint.h>
#include <string.h>

#include "psa/client.h"
#include "psa_manifest/sid.h"
#include "psa/error.h"
#include "psa/storage_common.h"
#include "psa/internal_trusted_storage.h"
#include "psa/protected_storage.h"

/* Wire header + ops, kept in lockstep with storage_service.h (the SPM-side
 * definition is not includable from Non-secure code). */
typedef struct {
    uint64_t uid;
    uint32_t flags;
    uint32_t offset;
} wt_its_wire_t;

#define WT_ITS_WIRE_SET         1
#define WT_ITS_WIRE_GET         2
#define WT_ITS_WIRE_GET_INFO    3
#define WT_ITS_WIRE_REMOVE      4
#define WT_PS_WIRE_CREATE       5
#define WT_PS_WIRE_SET_EXTENDED 6
#define WT_PS_WIRE_GET_SUPPORT  7

/* The vault refuses objects larger than its copied-transfer bound; the
 * dev_apis Storage suite stays well under this (UID_MAX_SIZE 512). */
#define WT_NS_STORAGE_MAX 512U

/* Map the SERVICE reply (a PSA status) to the ITS/PS return type. Both PSA
 * storage APIs return psa_status_t, so the values pass through unchanged. */
static psa_status_t wt_storage_ns_write(uint32_t sid, int32_t op, uint64_t uid,
                                        uint32_t flags, uint32_t offset,
                                        const void* data, size_t len)
{
    uint8_t buffer[sizeof(wt_its_wire_t) + WT_NS_STORAGE_MAX];
    wt_its_wire_t hdr;
    psa_handle_t handle;
    psa_invec in_vec[1];
    psa_status_t status;

    /* PSA Storage 1.0: an inaccessible data pointer (NULL with a nonzero
     * length) is invalid before any marshalling; a valid object the local
     * bounce buffer cannot carry is an insufficient-storage condition, not an
     * argument error. */
    if (data == NULL && len > 0U) {
        return PSA_ERROR_INVALID_ARGUMENT;
    }
    if (len > WT_NS_STORAGE_MAX) {
        return PSA_ERROR_INSUFFICIENT_STORAGE;
    }
    hdr.uid = uid;
    hdr.flags = flags;
    hdr.offset = offset;
    (void)memcpy(buffer, &hdr, sizeof(hdr));
    if (len > 0U) {
        (void)memcpy(buffer + sizeof(hdr), data, len);
    }
    handle = psa_connect(sid, 1U);
    if (handle <= 0) {
        return PSA_ERROR_GENERIC_ERROR;
    }
    in_vec[0].base = buffer;
    in_vec[0].len = sizeof(hdr) + len;
    status = psa_call(handle, op, in_vec, 1U, NULL, 0U);
    psa_close(handle);
    return status;
}

static psa_status_t wt_storage_ns_read(uint32_t sid, int32_t op, uint64_t uid,
                                       uint32_t offset, void* out,
                                       size_t out_cap, size_t* out_len)
{
    wt_its_wire_t hdr;
    psa_handle_t handle;
    psa_invec in_vec[1];
    psa_outvec out_vec[1];
    psa_status_t status;

    /* p_data_length must receive the bytes written on success (zero
     * included), so a NULL output pointer is an invalid argument — as is a
     * NULL data buffer with a nonzero capacity (the storage API pins -135,
     * where the raw FF-M vector check would classify a programmer error). */
    if (out_len == NULL || (out == NULL && out_cap != 0U)) {
        return PSA_ERROR_INVALID_ARGUMENT;
    }
    hdr.uid = uid;
    hdr.flags = 0U;
    hdr.offset = offset;
    handle = psa_connect(sid, 1U);
    if (handle <= 0) {
        return PSA_ERROR_GENERIC_ERROR;
    }
    in_vec[0].base = &hdr;
    in_vec[0].len = sizeof(hdr);
    out_vec[0].base = out;
    out_vec[0].len = out_cap;
    status = psa_call(handle, op, in_vec, 1U, out_vec, 1U);
    psa_close(handle);
    *out_len = out_vec[0].len;
    return status;
}

static psa_status_t wt_storage_ns_get_info(uint32_t sid, uint64_t uid,
                                           struct psa_storage_info_t* info)
{
    /* The service replies with {capacity, size, flags, reserved} — the first
     * three fields translate to the PSA info struct. */
    uint32_t reply[4];
    size_t got = 0U;
    psa_status_t status;

    if (info == NULL) {
        return PSA_ERROR_INVALID_ARGUMENT;
    }
    status = wt_storage_ns_read(sid, WT_ITS_WIRE_GET_INFO, uid, 0U, reply,
                                sizeof(reply), &got);
    if (status != PSA_SUCCESS) {
        return status;
    }
    if (got < 3U * sizeof(uint32_t)) {
        return PSA_ERROR_GENERIC_ERROR;
    }
    info->capacity = (size_t)reply[0];
    info->size = (size_t)reply[1];
    info->flags = (psa_storage_create_flags_t)reply[2];
    return PSA_SUCCESS;
}

psa_status_t psa_its_set(psa_storage_uid_t uid, size_t data_length,
                         const void* p_data,
                         psa_storage_create_flags_t create_flags)
{
    return wt_storage_ns_write(SERVICE_ITS_SID, WT_ITS_WIRE_SET, uid,
                               create_flags, 0U, p_data, data_length);
}

psa_status_t psa_its_get(psa_storage_uid_t uid, size_t data_offset,
                         size_t data_size, void* p_data,
                         size_t* p_data_length)
{
    return wt_storage_ns_read(SERVICE_ITS_SID, WT_ITS_WIRE_GET, uid,
                              (uint32_t)data_offset, p_data, data_size,
                              p_data_length);
}

psa_status_t psa_its_get_info(psa_storage_uid_t uid,
                              struct psa_storage_info_t* p_info)
{
    return wt_storage_ns_get_info(SERVICE_ITS_SID, uid, p_info);
}

psa_status_t psa_its_remove(psa_storage_uid_t uid)
{
    return wt_storage_ns_write(SERVICE_ITS_SID, WT_ITS_WIRE_REMOVE, uid, 0U,
                               0U, NULL, 0U);
}

psa_status_t psa_ps_set(psa_storage_uid_t uid, size_t data_length,
                        const void* p_data,
                        psa_storage_create_flags_t create_flags)
{
    return wt_storage_ns_write(SERVICE_PS_SID, WT_ITS_WIRE_SET, uid,
                               create_flags, 0U, p_data, data_length);
}

psa_status_t psa_ps_get(psa_storage_uid_t uid, size_t data_offset,
                        size_t data_size, void* p_data,
                        size_t* p_data_length)
{
    return wt_storage_ns_read(SERVICE_PS_SID, WT_ITS_WIRE_GET, uid,
                              (uint32_t)data_offset, p_data, data_size,
                              p_data_length);
}

psa_status_t psa_ps_get_info(psa_storage_uid_t uid,
                             struct psa_storage_info_t* p_info)
{
    return wt_storage_ns_get_info(SERVICE_PS_SID, uid, p_info);
}

psa_status_t psa_ps_remove(psa_storage_uid_t uid)
{
    return wt_storage_ns_write(SERVICE_PS_SID, WT_ITS_WIRE_REMOVE, uid, 0U,
                               0U, NULL, 0U);
}

psa_status_t psa_ps_create(psa_storage_uid_t uid, size_t capacity,
                           psa_storage_create_flags_t create_flags)
{
    /* The service advertises no SET_EXTENDED support, so create is refused
     * NOT_SUPPORTED; forward it faithfully rather than fake success. */
    return wt_storage_ns_write(SERVICE_PS_SID, WT_PS_WIRE_CREATE, uid,
                               create_flags, (uint32_t)capacity, NULL, 0U);
}

psa_status_t psa_ps_set_extended(psa_storage_uid_t uid, size_t data_offset,
                                 size_t data_length, const void* p_data)
{
    return wt_storage_ns_write(SERVICE_PS_SID, WT_PS_WIRE_SET_EXTENDED, uid,
                               0U, (uint32_t)data_offset, p_data,
                               data_length);
}

uint32_t psa_ps_get_support(void)
{
    uint32_t caps = 0U;
    size_t got = 0U;

    if (wt_storage_ns_read(SERVICE_PS_SID, WT_PS_WIRE_GET_SUPPORT, 0U, 0U,
                           &caps, sizeof(caps), &got) != PSA_SUCCESS ||
            got < sizeof(caps)) {
        return 0U;
    }
    return caps;
}
```

&flash0 {
	/delete-node/ partitions;

	partitions {
		compatible = "fixed-partitions";
		#address-cells = <1>;
		#size-cells = <1>;

		slot0_ns_partition: partition@a0000 {
			label = "image-0-nonsecure";
			reg = <0x000a0000 DT_SIZE_K(128)>;
		};
	};
};
